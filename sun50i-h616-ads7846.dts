/dts-v1/;
/plugin/;

/ {
	fragment@0 {
		target = <&spi1>;
		__overlay__ {
			status = "okay";
		};
	};

	fragment@1 {
		target = <&spi1>;
		__overlay__ {
			#address-cells = <1>;
			#size-cells = <0>;
			ads7846: ads7846@2 {
				compatible = "ti,ads7846";
				reg = <2>;
	
				spi-max-frequency = <10000>;
				interrupt-parent = <&pio>;
				interrupts = <2 9 0x08>; /* PC9 IRQ_TYPE_LEVEL_LOW */
				pendown-gpio = <&pio 2 9 0>;
				pinctrl-names = "default";
				spi-cpol;
				spi-cpha;
	
				/* driver defaults, optional */
				ti,x-min = /bits/ 16 <0>;
				ti,y-min = /bits/ 16 <0>;
				ti,x-max = /bits/ 16 <0x0FFF>;
				ti,y-max = /bits/ 16 <0x0FFF>;
				ti,pressure-min = /bits/ 16 <0>;
				ti,pressure-max = /bits/ 16 <0xFFFF>;
				ti,x-plate-ohms = /bits/ 16 <400>;
	
				wakeup-source;
			};
		};
	};

	fragment@2 {
		target = <&spi1>;
		__overlay__ {
			pinctrl-names = "default";
			pinctrl-0 = <&spi1_pins>;
		};
	};
	__overrides__ {
		cs = <&ads7846>,"reg:0";
		speed = <&ads7846>,"spi-max-frequency:0";
		swapxy = <&ads7846>,"ti,swap-xy?";
		xmin = <&ads7846>,"ti,x-min;0";
		ymin = <&ads7846>,"ti,y-min;0";
		xmax = <&ads7846>,"ti,x-max;0";
		ymax = <&ads7846>,"ti,y-max;0";
		pmin = <&ads7846>,"ti,pressure-min;0";
		pmax = <&ads7846>,"ti,pressure-max;0";
		xohms = <&ads7846>,"ti,x-plate-ohms;0";
	};
};
